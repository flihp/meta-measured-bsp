## conf/layer.conf
```bitbake
# We have a conf and classes directory, add to BBPATH
BBPATH .= ":${LAYERDIR}"


BBFILES += " \
    ${LAYERDIR}/recipes-*/*/*.bb \
    ${LAYERDIR}/recipes-*/*/*.bbappend \
"

BBFILE_COLLECTIONS += "measured-bsp"
BBFILE_PATTERN_measured-bsp := "^${LAYERDIR}/"
BBFILE_PRIORITY_measured-bsp = "6"

LAYERDEPENDS_measured-bsp = "measured intel"
LAYERSERIES_COMPAT_measured-bsp = "sumo"
```

## conf/machine/intel-corei7-64_tpm-txt.conf
```bitbake
#@TYPE: Machine
#@NAME: intel-corei7-64-tpm-txt
#@DESCRIPTION: Machine configuration for 64 bit Intel Core i7 CPU with
#  TPM 1.2 & TXT.

require conf/machine/intel-corei7-64.conf

MACHINE_FEATURES += "tpm"
MACHINE_FEATURES += "txt"
```

## conf/machine/minnowboard-tpm-32.conf
```bitbake
#@TYPE: Machine
#@NAME: minnowboard-tpm-32

#@DESCRIPTION: Machine configuration for 32 bit Intel Core 2 CPU (and later) with MMX, SSE, SSE2, SSE3, and SSSE3 instruction set support, and PTT.

require conf/machine/include/meta-intel.inc
require conf/machine/include/intel-core2-32-common.inc
require conf/machine/include/intel-common-pkgarch.inc

MACHINE_FEATURES += "efi"
MACHINE_FEATURES += "va-impl-intel"
MACHINE_FEATURES += "intel-ucode"
MACHINE_FEATURES += "tpm2"

MACHINE_EXTRA_RRECOMMENDS += "linux-firmware"

XSERVER ?= "${XSERVER_X86_BASE} \
            ${XSERVER_X86_EXT} \
            ${XSERVER_X86_FBDEV} \
            ${XSERVER_X86_I915} \
            ${XSERVER_X86_I965} \
            ${XSERVER_X86_MODESETTING} \
            ${XSERVER_X86_VESA} \
           "

SYSLINUX_OPTS = "serial 0 115200"
SERIAL_CONSOLES = "115200;ttyS0 115200;ttyPCH0"
APPEND += "console=ttyS0,115200 console=ttyPCH0,115200 console=tty0"

PACKAGE_INSTALL_append_pn-core-image-minimal-initramfs = " linux-firmware-i915"

EFI_PROVIDER = "grub-efi"
```

## meta-edison/conf/layer.conf
```bitbake
# We have a conf and classes directory, add to BBPATH
BBPATH := "${BBPATH}:${LAYERDIR}"

# We have a recipes-* directories, add to BBFILES
BBFILES := " \
    ${BBFILES} \
    ${LAYERDIR}/recipes-*/*/*.bbappend \
    ${LAYERDIR}/recipes-*/*/*.bb \
"

BBFILE_COLLECTIONS += "measured-edison"
BBFILE_PATTERN_measured-edison = "^${LAYERDIR}/"
BBFILE_PRIORITY_measured-edison = "6"
```

## meta-nuc/conf/layer.conf
```bitbake
# We have a conf and classes directory, add to BBPATH
BBPATH .= ":${LAYERDIR}"

# We have ... no recipes.
# BBFILES += ""

BBFILE_COLLECTIONS += "measured-nuc"
BBFILE_PATTERN_measured-nuc := ""
BBFILE_PRIORITY_measured-nuc = "6"

LAYERDEPENDS_measured-nuc = "measured nuc"
```
